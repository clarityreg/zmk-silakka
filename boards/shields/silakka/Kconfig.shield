## boards/shields/silakka/Kconfig.shield
```kconfig
# Copyright (c) 2020 Pete Johanson
# SPDX-License-Identifier: MIT

config SHIELD_SILAKKA_LEFT
    def_bool $(shields_list_contains,silakka_left)

config SHIELD_SILAKKA_RIGHT
    def_bool $(shields_list_contains,silakka_right)

config SHIELD_SILAKKA_LEFT_PERIPHERAL
    def_bool $(shields_list_contains,silakka_left_peripheral)
```
